CONSTANT COM_ADD =	0;
CONSTANT COM_SUB =	1;
CONSTANT COM_INC =	2;
CONSTANT COM_DEC =	3;
CONSTANT COM_CPL =	4;
CONSTANT COM_AND =	5;
CONSTANT COM_OR =		6;
CONSTANT COM_XOR =	7;
CONSTANT COM_RR =		8;
CONSTANT COM_RL =		9;
CONSTANT COM_SWAP =	10;

CONSTANT COM_DATA =		H"13";
CONSTANT COM_TABLE =		H"14";
CONSTANT COM_RET =		H"15";
CONSTANT COM_CALL =		H"16";
CONSTANT COM_JC =			H"17";
CONSTANT COM_JZ =			H"18";
CONSTANT COM_STORE =		H"19";
CONSTANT COM_LOAD =		H"1A";
CONSTANT COM_OUT =		H"1B";
CONSTANT COM_IN =			H"1C";
CONSTANT COM_SET =		H"1D";
CONSTANT COM_JMP =		H"1E";
CONSTANT COM_MOV =		H"1F";
	
